## base_external/configs/qemu_aarch64_virt_defconfig
```kconfig
BR2_aarch64=y
BR2_TOOLCHAIN_BUILDROOT_GLIBC=y

BR2_TARGET_GENERIC_HOSTNAME="aesd"
BR2_TARGET_GENERIC_ISSUE="AESD Assignment"

BR2_ROOTFS_OVERLAY=""
BR2_TARGET_GENERIC_GETTY_PORT="ttyAMA0"

BR2_SYSTEM_DHCP="eth0"

BR2_PACKAGE_AESD_ASSIGNMENTS=y
```
